## PetaLinux/bsp/uzev/project-spec/meta-avnet/conf/layer.conf
```bitbake
# We have a conf and classes directory, add to BBPATH
BBPATH .= ":${LAYERDIR}"

# We have recipes-* directories, add to BBFILES
BBFILES += "${LAYERDIR}/recipes-*/*/*.bb \
	${LAYERDIR}/recipes-*/*/*.bbappend"

BBFILE_COLLECTIONS += "meta-avnet"
BBFILE_PATTERN_meta-avnet = "^${LAYERDIR}/"
BBFILE_PRIORITY_meta-avnet = "7"
LAYERSERIES_COMPAT_meta-avnet = "honister"
```

## PetaLinux/bsp/uzev/project-spec/meta-avnet/conf/machine/mz7020-som.conf
```bitbake
#@TYPE: Machine
#@NAME: mz7020-som
#@DESCRIPTION: Machine support for Microzed 7020 SOM.
#

MACHINEOVERRIDES = "mz:${MACHINE}"

require conf/machine/include/soc-zynq.inc
require conf/machine/include/machine-xilinx-default.inc

MACHINE_FEATURES = "rtc ext2 ext3 vfat usbhost usbgadget"

EXTRA_IMAGEDEPENDS += "libyaml-native python3-cython-native python3-pyyaml-native"

UBOOT_MACHINE = "xilinx_zynq_virt_defconfig"

# prevent U-Boot from deploying the boot.bin
SPL_BINARY ?= ""

SERIAL_CONSOLES ?= "115200;ttyPS0"

MACHINE_ESSENTIAL_EXTRA_RDEPENDS += "device-tree"

EXTRA_IMAGEDEPENDS += " \
        virtual/bootloader \
        u-boot-zynq-scr \
        virtual/fsbl \
        avnet-boot-scr \
        "

# Used to create a wic image to boot from emmc
IMAGE_BOOT_FILES = " \
                    boot.bin \
                    boot.scr \
                    fitImage;image.ub \
                    "

# deploy avnet-boot-scr scripts in images/linux/ folder
EXTRA_FILESLIST:append = " ${DEPLOY_DIR_IMAGE}/avnet-boot/:avnet-boot/ "
```

## PetaLinux/bsp/uzev/project-spec/meta-avnet/conf/machine/pz7010-fmc2.conf
```bitbake
#@TYPE: Machine
#@NAME: pz7010-fmc2
#@DESCRIPTION: Machine support for Picozed 7010 with FMC2.
#

MACHINEOVERRIDES = "pz:${MACHINE}"

require conf/machine/include/soc-zynq.inc
require conf/machine/include/machine-xilinx-default.inc

MACHINE_FEATURES = "rtc ext2 ext3 vfat usbhost usbgadget"

EXTRA_IMAGEDEPENDS += "libyaml-native python3-cython-native python3-pyyaml-native"

UBOOT_MACHINE = "xilinx_zynq_virt_defconfig"

# prevent U-Boot from deploying the boot.bin
SPL_BINARY ?= ""

SERIAL_CONSOLES ?= "115200;ttyPS0"

MACHINE_ESSENTIAL_EXTRA_RDEPENDS += "device-tree"

EXTRA_IMAGEDEPENDS += " \
        virtual/bootloader \
        u-boot-zynq-scr \
        virtual/fsbl \
        avnet-boot-scr \
        "

# Used to create a wic image to boot from emmc
IMAGE_BOOT_FILES = " \
                    boot.bin \
                    avnet-boot/avnet_mmc_ext4.scr;boot.scr \
                    fitImage;image.ub \
                    "

# deploy avnet-boot-scr scripts in images/linux/ folder
EXTRA_FILESLIST:append = " ${DEPLOY_DIR_IMAGE}/avnet-boot/:avnet-boot/ "
```

## PetaLinux/bsp/uzev/project-spec/meta-avnet/conf/machine/u96v2-sbc.conf
```bitbake
#@TYPE: Machine
#@NAME: u96v2-sbc
#@DESCRIPTION: Machine support for Ultra96v2.
#

MACHINEOVERRIDES = "ultra96:ultra96-zynqmp:${MACHINE}"

require conf/machine/include/soc-zynqmp.inc
require conf/machine/include/machine-xilinx-default.inc

MACHINE_FEATURES = "rtc ext2 ext3 vfat usbhost usbgadget wifi bluetooth"

UBOOT_MACHINE = "xilinx_zynqmp_virt_defconfig"
# prevent U-Boot from deploying the boot.bin
SPL_BINARY = ""

SERIAL_CONSOLES ?= "115200;ttyPS0"

PMU_FIRMWARE_IMAGE_NAME ?= "pmu-firmware-zynqmp-pmu"
PMU_FIRMWARE_DEPLOY_DIR ?= "${TOPDIR}/pmutmp/deploy/images/zynqmp-pmu"

EXTRA_IMAGEDEPENDS += " \
		arm-trusted-firmware \
		virtual/bootloader \
		u-boot-zynq-scr \
		virtual/fsbl \
		virtual/pmu-firmware \
		avnet-boot-scr \
		"

# Used to create a wic image to boot from sd
IMAGE_BOOT_FILES = " \
                    boot.bin \
                    boot.scr \
                    fitImage;image.ub \
                    "

# deploy avnet-boot-scr scripts in images/linux/ folder
EXTRA_FILESLIST:append = " ${DEPLOY_DIR_IMAGE}/avnet-boot/:avnet-boot/ "

MACHINE_ESSENTIAL_EXTRA_RRECOMMENDS += "linux-firmware-wl18xx"

EXTRA_IMAGEDEPENDS:remove = "qemu-devicetrees"

DISTRO_FEATURES:append = " bluez5 dbus"

PACKAGE_FEED_URIS = "http://petalinux.xilinx.com/sswreleases/sswboardfeeds/"
PACKAGE_FEED_BASE_PATHS = "zzsoc"
PACKAGE_FEED_ARCHS = "all aarch64 plnx_aarch64"
```

## PetaLinux/bsp/uzev/project-spec/meta-avnet/conf/machine/uz3eg-iocc.conf
```bitbake
#@TYPE: Machine
#@NAME: uz3eg-iocc
#@DESCRIPTION: Machine support for UltraZed-EG with IOCC.
#

SOC_VARIANT = "eg"

MACHINEOVERRIDES = "uz:uz3eg:${MACHINE}"

require conf/machine/include/soc-zynqmp.inc
require conf/machine/include/machine-xilinx-default.inc

MACHINE_FEATURES = "rtc ext2 ext3 vfat usbhost"

EXTRA_IMAGEDEPENDS += "libyaml-native python3-cython-native python3-pyyaml-native"

UBOOT_MACHINE = "xilinx_zynqmp_virt_defconfig"

# prevent U-Boot from deploying the boot.bin
SPL_BINARY ?= ""

SERIAL_CONSOLES ?= "115200;ttyPS0"

EXTRA_IMAGEDEPENDS += " \
		arm-trusted-firmware \
		virtual/bootloader \
		u-boot-zynq-scr \
		virtual/fsbl \
		virtual/pmu-firmware \
		avnet-boot-scr \
		"

# Used to create a wic image to boot from emmc
IMAGE_BOOT_FILES = " \
                    boot.bin \
                    avnet-boot/avnet_mmc_ext4.scr;boot.scr \
                    fitImage;image.ub \
                    "

PMU_FIRMWARE_IMAGE_NAME ?= "pmu-firmware-zynqmp-pmu"
PMU_FIRMWARE_DEPLOY_DIR ?= "${TOPDIR}/pmutmp/deploy/images/zynqmp-pmu"

# deploy avnet-boot-scr scripts in images/linux/ folder
EXTRA_FILESLIST:append = " ${DEPLOY_DIR_IMAGE}/avnet-boot/:avnet-boot/ "

EXTRA_IMAGEDEPENDS:remove = "qemu-devicetrees"

PACKAGE_FEED_URIS = "http://petalinux.xilinx.com/sswreleases/sswboardfeeds/"
PACKAGE_FEED_BASE_PATHS = "zzsoc"
PACKAGE_FEED_ARCHS = "all aarch64 plnx_aarch64"
```

## PetaLinux/bsp/uzev/project-spec/meta-avnet/conf/machine/uz7ev-evcc-hdmi.conf
```bitbake
#@TYPE: Machine
#@NAME: uz7ev-evcc-hdmi
#@DESCRIPTION: Machine support for UltraZed-EV with EVCC, including HDMI support.
#

SOC_VARIANT = "ev"

MACHINEOVERRIDES = "uz:uz7ev:uz7ev-evcc:${MACHINE}"

require conf/machine/include/soc-zynqmp.inc
require conf/machine/include/machine-xilinx-default.inc

MACHINE_FEATURES = "rtc ext2 ext3 vfat usbhost"

EXTRA_IMAGEDEPENDS += "libyaml-native python3-cython-native python3-pyyaml-native"

UBOOT_MACHINE = "xilinx_zynqmp_virt_defconfig"

# prevent U-Boot from deploying the boot.bin
SPL_BINARY ?= ""

SERIAL_CONSOLES ?= "115200;ttyPS0"

EXTRA_IMAGEDEPENDS += " \
		arm-trusted-firmware \
		virtual/bootloader \
		u-boot-zynq-scr \
		virtual/fsbl \
		virtual/pmu-firmware \
		avnet-boot-scr \
		"

# Used to create a wic image to boot from emmc
IMAGE_BOOT_FILES = " \
                    boot.bin \
                    avnet-boot/avnet_mmc_ext4.scr;boot.scr \
                    fitImage;image.ub \
                    "

PMU_FIRMWARE_IMAGE_NAME ?= "pmu-firmware-zynqmp-pmu"
PMU_FIRMWARE_DEPLOY_DIR ?= "${TOPDIR}/pmutmp/deploy/images/zynqmp-pmu"

# deploy avnet-boot-scr scripts in images/linux/ folder
EXTRA_FILESLIST:append = " ${DEPLOY_DIR_IMAGE}/avnet-boot/:avnet-boot/ "

EXTRA_IMAGEDEPENDS:remove = "qemu-devicetrees"
```

## PetaLinux/bsp/uzev/project-spec/meta-avnet/recipes-core/images/avnet-image-full.wks
```
# short-description: Create EMMC image with a boot partition
# long-description: Creates a partitioned EMMC image. Boot files
# are located in the first vfat partition.

part /boot --source bootimg-partition --ondisk mmcblk0 --fstype=vfat --label boot --active --align 4 --fixed-size 1G
part / --source rootfs --ondisk mmcblk0 --fstype=ext4 --label root --align 4 --extra-space 1G
```

## PetaLinux/bsp/zcu208/project-spec/meta-user/wic/petalinux-sdimage.wks
```
# SD-card image for PetaLinux flow: 2-partition layout
# (FAT32 'boot' + ext4 'root').
#
# - p1 'boot' (FAT32, 1 GiB) holds BOOT.BIN, boot.scr, and the kernel
#   (image.ub / Image / uImage) and any other files listed in
#   IMAGE_BOOT_FILES. The SoC BootROM reads BOOT.BIN from this partition.
# - p2 'root' (ext4, fills the card) is the rootfs.
#
# Flash with: scripts/copy_to_sd.sh -petalinux -repo <r> -target <t>
# (the script detects rootfs.wic.xz and dd's it onto the SD card's raw
#  block device, replacing whatever was there before).

bootloader --ptable msdos
part /boot --source bootimg-partition --ondisk mmcblk0 --fstype=vfat --label boot --active --align 1024 --size 1024
part /     --source rootfs            --ondisk mmcblk0 --fstype=ext4 --label root --align 1024
```
