/include/ "system-conf.dtsi"
/ {
};

	/delete-node/ &xdma_0;
  
	&amba_pl {

		xdma_0: axi-pcie@0400000000 {
			#address-cells = <2>;
			#interrupt-cells = <2>;
			#size-cells = <2>;
			compatible = "xlnx,xdma-host-3.00";
			device_type = "pci";
			interrupt-map = <0 0 0 1 &pcie_intc_0 1>, <0 0 0 2 &pcie_intc_0 2>, <0 0 0 3 &pcie_intc_0 3>, <0 0 0 4 &pcie_intc_0 4>;
			interrupt-map-mask = <0 0 0 7>;
			interrupt-names = "misc", "msi0", "msi1";
			interrupt-parent = <&gic>;
			interrupts = <0 89 4>, <0 90 4>, <0 91 4>;
			ranges = <0x02000000 0x00000000 0xA0000000 0x00000000 0xA0000000 0x00000000 0x10000000>;
			reg = <0x00000004 0x00000000 0x0 0x20000000>;
			pcie_intc_0: interrupt-controller {
				#address-cells = <0>;
				#interrupt-cells = <1>;
				interrupt-controller ;
			};
		};
	};

