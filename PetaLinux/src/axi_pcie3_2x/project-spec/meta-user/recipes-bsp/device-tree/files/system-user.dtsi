/include/ "system-conf.dtsi"
/ {
};

	&axi_pcie3_0 {
		ranges = <0x02000000 0x00000000 0x0000000060000000 0x0000000060000000 0x00000000 0x10000000>;
	};

	&axi_pcie3_1 {
		ranges = <0x02000000 0x00000000 0x0000000070000000 0x0000000070000000 0x00000000 0x10000000>;
	};
