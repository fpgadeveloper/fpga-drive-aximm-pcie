// SPDX-License-Identifier: MIT
// Copyright (C) 2025-2026, Opsero Electronic Design Inc.  All rights reserved.

/*
 * SoC-side / PL device-tree fixups for VPK180, layered on top of the
 * gen-machineconf / lopper-generated <...>-linux.dts (which already carries
 * the PS config and the PL xilinx_qdma PCIe Root Port from the XSA via
 * pl.dtsi). Scoped to the Linux domain by device-tree.bbappend.
 *
 * VPK180 is a single-QDMA design (one PCIe Root Port -> SSD1), so only qdma_0
 * is overridden.
 *
 * PCIe outbound-window fix (qdma_0 `ranges`):
 *   The Versal QDMA bridge forwards CPU addresses 1:1 to the PCIe bus, but the
 *   SDT/lopper-generated `ranges` set the PCI base to 0x0, so endpoint BAR
 *   accesses fault (Asynchronous SError, panic in nvme_pci_enable). Identity-
 *   map both the 32-bit MEM and 64-bit (prefetchable) windows to match
 *   PetaLinux's HSI DT.
 *
 * reg / reg-names reorder:
 *   The upstream xilinx-xdma-pcie driver's parse_dt takes reg index 0 as the
 *   "cfg" region, but pl.dtsi on this board emits reg-names = "breg","cfg"
 *   (breg at index 0). Restate reg with cfg first so the driver finds the ECAM
 *   window. Ported verbatim from PetaLinux/bsp/vpk180; the cfg/breg base
 *   addresses are fixed by the Versal CPM/PL map. (Verify against the generated
 *   linux.dts if the QDMA fails to probe.)
 *
 *   ranges format: <pci_addr(3) cpu_addr(2) size(2)>.
 */

&qdma_0 {
	reg = <0x0 0x90000000 0x0 0x10000000>, <0x0 0x80000000 0x0 0x10000000>;
	reg-names = "cfg", "breg";
	ranges = <0x02000000 0x00 0xa8000000  0x00 0xa8000000  0x00 0x08000000>,
		 <0x43000000 0x04 0x80000000  0x04 0x80000000  0x00 0x40000000>;
};

/* Board RJ45 (GEM0 = u198 PHY; GEM1 is not used on this board): the SDT
 * flow does not describe the board-level TI DP83867 PHY, so Linux falls
 * back to the Generic PHY driver and the RGMII clock delays are never
 * programmed - the link negotiates 1G but passes no packets.
 * Values from the official versal-vpk180-revA.dts (PHY addr 1,
 * RX delay 3.00 ns = 0xb, TX delay 2.75 ns = 0xa); reset-gpios omitted
 * because the SDT device tree does not define the gpio1 label - the PHY
 * powers up out of reset from straps. Same fix as the HW-verified
 * 2x-qsfp28-fmc vck190 Yocto BSP, but NOT yet verified on a VPK180.
 * No fixed MAC: the MAC stays random per boot (add a local-mac-address
 * property to pin one).
 */
&gem0 {
	phy-handle = <&gem0_phy>;
	mdio {
		#address-cells = <1>;
		#size-cells = <0>;
		gem0_phy: ethernet-phy@1 {
			compatible = "ethernet-phy-id2000.a231";
			reg = <1>;
			ti,rx-internal-delay = <0xb>;
			ti,tx-internal-delay = <0xa>;
			ti,fifo-depth = <0x1>;
			ti,dp83867-rxctrl-strap-quirk;
		};
	};
};
